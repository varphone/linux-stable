## Documentation/devicetree/bindings/mfd/atm88pa.txt
```
* Atmel Microelectronics ATMEGA88PA Multi-Functional Device

Required properties:
 - compatible			: "tdc,atm88pa"
 - reg				: I2C address of the device
 - interrupts			: The interrupt output from the controller
 - interrupt-parent		: Specifies which IRQ controller we're connected to
 - linux,wakeup			: Marks the input device as wakable
 - keypad
  - debounce_time		: Key press debounce time in ms
  - repeat			: Key repeat delay in ms
  - keymap			: Key code mapping
 - leds
  - id				: Index number
  - label			: Text identifer
  - brightness			: Brightness
  - max-brightness		: Maximum brightness
 - power			: Power managerment
  - gpios			: Specifies which gpio we're connected to power management

Optional properties:
 - leds
  - default-trigger		: Default trigger

Notes:
 - KEY_ENTER			: Show menu or dialog or confirm
 - KEY_ESC			: Cancel or back to prev
 - KEY_UP			: Move up or do plus
 - KEY_DOWN			: Move down or do minus
 - KEY_F4			: Toggle front/back camera
 - KEY_F5			: Toggle video display mode
 - KEY_F6			: Toggle supplementary lighting
 - KEY_POWER			: Power on/off

Example:

	atm88pa: atm88pa@7a {
		compatible = "tdc,atm88pa";
		reg = <0x7a>;
		interrupt-parent = <&gpio5>;
		interrupts = <20 0x04>;
		linux,wakeup;
		
		keypad {
			debounce_time = <1>;
			repeat = <0>;
			/* KEY_ENTER, KEY_ESC, KEY_UP, KEY_DOWN, KEY_F4, KEY_F5, KEY_F6, KEY_POWER */
			keymap = /bits/ 16 <28 1 103 108 62 63 64 116>;
		};

		leds {
			l-led1@0 {
				id = <0>;
				label = "l-led1";
				brightness = <0>;
				max-brightness = <255>;
			};
			l-led2@1 {
				id = <1>;
				label = "l-led2";
				brightness = <0>;
				max-brightness = <255>;
			};
			r-led1@2 {
				id = <2>;
				label = "r-led1";
				brightness = <0>;
				max-brightness = <255>;
			};
		};

		power {
			/* poweroff-gpio: GPIO1_IO13, ACTIVE_LOW */
			gpios = <&gpio1 13 1>;
		};
	};
```

## arch/arm/configs/myimx6_mfg_defconfig
```kconfig
CONFIG_EXPERIMENTAL=y
CONFIG_SYSVIPC=y
CONFIG_IKCONFIG=y
CONFIG_IKCONFIG_PROC=y
CONFIG_LOG_BUF_SHIFT=14
CONFIG_BLK_DEV_INITRD=y
CONFIG_EMBEDDED=y
CONFIG_PERF_EVENTS=y
CONFIG_MODULES=y
CONFIG_MODULE_UNLOAD=y
CONFIG_MODULE_FORCE_UNLOAD=y
CONFIG_MODVERSIONS=y
# CONFIG_BLK_DEV_BSG is not set
CONFIG_ARCH_MXC=y
CONFIG_GPIO_PCA953X=y
CONFIG_ARCH_MX6=y
CONFIG_MACH_MX6Q_ARM2=y
CONFIG_MACH_MX6SL_ARM2=y
CONFIG_MACH_MX6Q_SABRELITE=y
CONFIG_MACH_MX6Q_SABRESD=y
CONFIG_MACH_MX6Q_SABREAUTO=y
CONFIG_MACH_MX6Q_HDMIDONGLE=y
CONFIG_MACH_MYIMX6EK200=y
CONFIG_MACH_MYIMX6EK314=y
CONFIG_IMX_PCIE=y
CONFIG_USB_FSL_ARC_OTG=y
CONFIG_MXC_PWM=y
CONFIG_CLK_DEBUG=y
CONFIG_DMA_ZONE_SIZE=184
# CONFIG_SWP_EMULATE is not set
CONFIG_ARM_ERRATA_743622=y
CONFIG_ARM_ERRATA_751472=y
CONFIG_PL310_ERRATA_769419=y
CONFIG_NO_HZ=y
CONFIG_HIGH_RES_TIMERS=y
CONFIG_SMP=y
CONFIG_VMSPLIT_2G=y
# CONFIG_LOCAL_TIMERS is not set
CONFIG_PREEMPT=y
CONFIG_AEABI=y
# CONFIG_OABI_COMPAT is not set
CONFIG_HIGHMEM=y
CONFIG_ZBOOT_ROM_TEXT=0x0
CONFIG_ZBOOT_ROM_BSS=0x0
CONFIG_CMDLINE="noinitrd console=ttymxc0,115200 root=/dev/mtdblock2 rw rootfstype=jffs2 ip=off"
CONFIG_AUTO_ZRELADDR=y
CONFIG_CPU_FREQ=y
CONFIG_CPU_FREQ_GOV_POWERSAVE=y
CONFIG_CPU_FREQ_GOV_USERSPACE=y
CONFIG_CPU_FREQ_GOV_CONSERVATIVE=y
CONFIG_CPU_FREQ_IMX=y
CONFIG_VFP=y
CONFIG_NEON=y
# CONFIG_CORE_DUMP_DEFAULT_ELF_HEADERS is not set
CONFIG_SUSPEND_DEVICE_TIME_DEBUG=y
CONFIG_PM_RUNTIME=y
CONFIG_PM_DEBUG=y
CONFIG_APM_EMULATION=y
CONFIG_NET=y
CONFIG_PACKET=y
CONFIG_UNIX=y
CONFIG_INET=y
CONFIG_IP_MULTICAST=y
CONFIG_IP_PNP=y
CONFIG_IP_PNP_DHCP=y
CONFIG_IP_PNP_BOOTP=y
# CONFIG_INET_LRO is not set
# CONFIG_IPV6 is not set
CONFIG_CAN=y
CONFIG_CAN_RAW=y
CONFIG_CAN_BCM=y
CONFIG_CAN_VCAN=y
# CONFIG_CAN_DEV is not set
CONFIG_CAN_DEBUG_DEVICES=y
CONFIG_BT=y
CONFIG_BT_L2CAP=y
CONFIG_BT_SCO=y
CONFIG_BT_RFCOMM=y
CONFIG_BT_RFCOMM_TTY=y
CONFIG_BT_BNEP=y
CONFIG_BT_BNEP_MC_FILTER=y
CONFIG_BT_BNEP_PROTO_FILTER=y
CONFIG_BT_HIDP=y
CONFIG_BT_HCIBTUSB=y
CONFIG_BT_HCIVHCI=y
CONFIG_RFKILL=y
CONFIG_RFKILL_INPUT=y
CONFIG_UEVENT_HELPER_PATH="/sbin/hotplug"
CONFIG_CONNECTOR=y
CONFIG_MTD=y
CONFIG_MTD_CHAR=y
CONFIG_MTD_BLOCK=y
CONFIG_MTD_CFI=y
CONFIG_MTD_CFI_AMDSTD=y
CONFIG_MTD_PHYSMAP=y
CONFIG_MTD_M25P80=y
CONFIG_MTD_NAND=y
CONFIG_MTD_NAND_GPMI_NAND=y
CONFIG_MTD_UBI=y
CONFIG_BLK_DEV_LOOP=y
CONFIG_SCSI=y
CONFIG_BLK_DEV_SD=y
CONFIG_SCSI_MULTI_LUN=y
CONFIG_ATA=m
# CONFIG_SATA_PMP is not set
CONFIG_SATA_AHCI_PLATFORM=m
CONFIG_NETDEVICES=y
CONFIG_NET_ETHERNET=y
CONFIG_SMSC911X=y
# CONFIG_NETDEV_1000 is not set
# CONFIG_NETDEV_10000 is not set
CONFIG_USB_USBNET=y
# CONFIG_USB_NET_AX8817X is not set
# CONFIG_USB_NET_CDCETHER is not set
# CONFIG_USB_NET_CDC_NCM is not set
CONFIG_USB_NET_SMSC95XX=y
# CONFIG_USB_NET_NET1080 is not set
# CONFIG_USB_NET_CDC_SUBSET is not set
# CONFIG_USB_NET_ZAURUS is not set
CONFIG_PPP=y
CONFIG_PPP_ASYNC=y
CONFIG_PPP_MPPE=y
CONFIG_INPUT_POLLDEV=y
CONFIG_INPUT_EVDEV=y
# CONFIG_INPUT_KEYBOARD is not set
# CONFIG_INPUT_MOUSE is not set
CONFIG_INPUT_TOUCHSCREEN=y
CONFIG_TOUCHSCREEN_EGALAX=y
CONFIG_TOUCHSCREEN_FT5X06=y
CONFIG_INPUT_MISC=y
CONFIG_INPUT_UINPUT=y
# CONFIG_SERIO is not set
CONFIG_SERIAL_IMX=y
CONFIG_SERIAL_IMX_CONSOLE=y
CONFIG_FSL_OTP=y
CONFIG_HW_RANDOM=y
CONFIG_MXS_VIIM=y
CONFIG_I2C=y
CONFIG_I2C_CHARDEV=y
CONFIG_I2C_IMX=y
CONFIG_SPI=y
CONFIG_SPI_IMX=y
CONFIG_SPI_SPIDEV=y
# CONFIG_HWMON is not set
CONFIG_THERMAL=y
CONFIG_WATCHDOG=y
CONFIG_WATCHDOG_NOWAYOUT=y
CONFIG_IMX2_WDT=y
CONFIG_MFD_PFUZE=y
CONFIG_MFD_MAX17135=y
CONFIG_REGULATOR=y
CONFIG_REGULATOR_FIXED_VOLTAGE=y
CONFIG_REGULATOR_PFUZE100=y
CONFIG_REGULATOR_MAX17135=y
CONFIG_MEDIA_SUPPORT=y
CONFIG_VIDEO_DEV=y
# CONFIG_RC_CORE is not set
# CONFIG_MEDIA_TUNER_CUSTOMISE is not set
# CONFIG_VIDEO_MXC_CAMERA is not set
# CONFIG_V4L_USB_DRIVERS is not set
# CONFIG_RADIO_ADAPTERS is not set
CONFIG_FB=y
CONFIG_FB_MXC_LDB=y
CONFIG_FB_MXC_HDMI=y
CONFIG_FRAMEBUFFER_CONSOLE=y
CONFIG_FONTS=y
CONFIG_FONT_8x16=y
CONFIG_LOGO=y
CONFIG_SOUND=y
CONFIG_SND=y
CONFIG_SND_SOC=y
CONFIG_SND_IMX_SOC=y
CONFIG_SND_SOC_IMX_CS42888=y
CONFIG_HID_A4TECH=m
CONFIG_HID_APPLE=m
CONFIG_HID_BELKIN=m
CONFIG_HID_CHERRY=m
CONFIG_HID_CHICONY=m
CONFIG_HID_CYPRESS=m
CONFIG_HID_EZKEY=m
CONFIG_HID_GYRATION=m
CONFIG_HID_LOGITECH=m
CONFIG_HID_MICROSOFT=m
CONFIG_HID_MONTEREY=m
CONFIG_HID_PANTHERLORD=m
CONFIG_HID_PETALYNX=m
CONFIG_HID_SAMSUNG=m
CONFIG_HID_SONY=m
CONFIG_HID_SUNPLUS=m
CONFIG_USB=y
CONFIG_USB_DEVICEFS=y
# CONFIG_USB_DEVICE_CLASS is not set
CONFIG_USB_SUSPEND=y
CONFIG_USB_STORAGE=y
CONFIG_USB_SERIAL=y
CONFIG_USB_SERIAL_OPTION=y
CONFIG_USB_GADGET=y
CONFIG_USB_FILE_STORAGE=y
CONFIG_FSL_UTP=y
CONFIG_MMC=y
CONFIG_MMC_UNSAFE_RESUME=y
CONFIG_MMC_SDHCI=y
CONFIG_MMC_SDHCI_PLTFM=y
CONFIG_MMC_SDHCI_ESDHC_IMX=y
CONFIG_RTC_CLASS=y
CONFIG_RTC_INTF_DEV_UIE_EMUL=y
CONFIG_RTC_DRV_ISL1208=y
CONFIG_RTC_DRV_SNVS=y
CONFIG_DMADEVICES=y
CONFIG_IMX_SDMA=y
CONFIG_STAGING=y
CONFIG_MXC_IPU=y
# CONFIG_MXC_HMP4E is not set
# CONFIG_MXC_HWEVENT is not set
CONFIG_MXC_ASRC=y
# CONFIG_ANATOP_THERMAL is not set
CONFIG_EXT2_FS=y
CONFIG_EXT3_FS=y
# CONFIG_EXT3_DEFAULTS_TO_ORDERED is not set
CONFIG_EXT4_FS=y
CONFIG_AUTOFS4_FS=m
CONFIG_MSDOS_FS=y
CONFIG_VFAT_FS=y
CONFIG_TMPFS=y
CONFIG_JFFS2_FS=y
CONFIG_UBIFS_FS=y
CONFIG_CRAMFS=y
CONFIG_NFS_FS=y
CONFIG_NFS_V3=y
CONFIG_ROOT_NFS=y
CONFIG_PARTITION_ADVANCED=y
CONFIG_EFI_PARTITION=y
CONFIG_NLS_CODEPAGE_437=y
CONFIG_NLS_ASCII=m
CONFIG_NLS_ISO8859_1=y
CONFIG_NLS_UTF8=m
CONFIG_DEBUG_FS=y
CONFIG_SYSCTL_SYSCALL_CHECK=y
CONFIG_CRYPTO_TEST=m
CONFIG_CRYPTO_CRYPTODEV=y
CONFIG_CRYPTO_CBC=y
CONFIG_CRYPTO_AES=y
# CONFIG_CRYPTO_ANSI_CPRNG is not set
```

## drivers/hiedmac/Kconfig
```kconfig
#
# Sensor device configuration
#

config HIEDMAC
	tristate "Hisilicon EDMAC Controller support"
	depends on (ARCH_HISI || ARCH_HI3559AV100 || ARCH_HI3519AV100 || ARCH_HI3556AV100)
	help
	  The Direction Memory Access(EDMA) is a high-speed data transfer
	  operation. It supports data read/write between peripherals and
	  memories without using the CPU.
	  Hisilicon EDMA Controller(EDMAC) directly transfers data between
	  a memory and a peripheral, between peripherals, or between memories.
	  This avoids the CPU intervention and reduces the interrupt handling
	  overhead of the CPU.

if HIEDMAC

config HIEDMAC_CHANNEL_NUM
	int "hiedmac channel num"
	default "8" if ARCH_HI3559AV100 || ARCH_HI3519AV100 || ARCH_HI3556AV100

endif
```

## drivers/media/i2c/nvp6324/Kconfig
```kconfig
config VIDEO_NVP6324
       tristate "Nextchip NVP6324 decoder"
       depends on VIDEO_V4L2 && I2C && VIDEO_V4L2_SUBDEV_API
       ---help---
          Support for the Nextchip NVP6324 AHD/CVBS to MIPI CSI-2 bridge.

          To compile this driver as a module, choose M here: the
          module will be called nvp6324.
```

## drivers/media/platform/hi3xxx/Kconfig
```kconfig
config VIDEO_HI3XXX
	tristate "Video Media Supports for Hisilicon Hi3XXX Platforms"
	depends on VIDEO_V4L2 && VIDEO_V4L2_SUBDEV_API && OF
	---help---
	   Driver for Hisilicon Hi3XXX Platforms Video Media.

if VIDEO_HI3XXX

config VIDEO_HI3XXX_MEDIA
	bool "Media Controller Supports"
	default y
	depends on VIDEO_HI3XXX
	---help---
	   Media Controller for the Hisilicon Hi3XXX Platforms.

config VIDEO_HI3XXX_VICAP
	bool "Video Input Capture Supports"
	default y
	depends on VIDEO_HI3XXX
	---help---
	   V4L2 Subdev for the Hisilicon Hi3XXX VICAP.

endif # VIDEO_HI3XXX
```

## drivers/net/wireless/realtek/rtl8188eu/Kconfig
```kconfig
menuconfig RTL8188EU
	tristate "MYZR for Realtek 8188E USB WiFi"
	depends on USB
	---help---
	  Help message of RTL8188EU

if RTL8188EU

choice
     prompt "Select driver version"
     default RTL8188EU_V4324

config RTL8188EU_V418
     depends on RTL8188EU
     tristate "v4.1.8"

config RTL8188EU_V4309
     depends on RTL8188EU
     tristate "v4.3.0.9"

config RTL8188EU_V4324
     depends on RTL8188EU
     tristate "v4.3.24"

config RTL8188EU_V5224
     depends on RTL8188EU
     tristate "v5.2.2.4"

endchoice
endif
```

## drivers/staging/mpcam/Kconfig
```kconfig
menuconfig MPCAM
	tristate "Mulitple Path Camera support"
	depends on ARCH_ZYNQ
	help
	  Mulitple Path Camera based on Xilinx Zynq FPGAs.

if MPCAM

endif # MPCAM
```

## drivers/usb/serial/mxuport/Kconfig
```kconfig
config USB_SERIAL_MXUPORT
	tristate "MOXA UPort series driver"
	help
		MOXA UPort series driver for 1200/1400/1600
		
```

## drivers/usb/serial/mxusbserial/Kconfig
```kconfig
config USB_SERIAL_MXUSBSERIAL
	tristate "MOXA USB Serial Bus"
	help
		MOXA USB Serial Bus
```
